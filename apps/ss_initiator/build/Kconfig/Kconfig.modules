## apps/ss_initiator/build/Kconfig/Kconfig.modules
```kconfig
menu "hal_nordic (/home/ggory15/zephyrproject/modules/hal/nordic)"
osource "$(ZEPHYR_HAL_NORDIC_KCONFIG)"
config ZEPHYR_HAL_NORDIC_MODULE
	bool
	default y
endmenu
menu "sof (/home/ggory15/zephyrproject/modules/audio/sof)"
osource "/home/ggory15/zephyrproject/modules/audio/sof/zephyr/Kconfig"
config ZEPHYR_SOF_MODULE
	bool
	default y
endmenu
menu "trusted-firmware-m (/home/ggory15/zephyrproject/modules/tee/tfm)"
osource "$(ZEPHYR_TRUSTED_FIRMWARE_M_KCONFIG)"
config ZEPHYR_TRUSTED_FIRMWARE_M_MODULE
	bool
	default y
endmenu
menu "nanopb (/home/ggory15/zephyrproject/modules/lib/nanopb)"
osource "$(ZEPHYR_NANOPB_KCONFIG)"
config ZEPHYR_NANOPB_MODULE
	bool
	default y
endmenu
```

## apps/ss_initiator/build/Kconfig/Kconfig.shield
```kconfig
osource "/home/ggory15/git/DWM1001_Firmware_Localization/apps/ss_initiator/../../boards/shields/*/Kconfig.shield"
osource "/home/ggory15/zephyrproject/zephyr/boards/shields/*/Kconfig.shield"
```

## apps/ss_initiator/build/Kconfig/Kconfig.shield.defconfig
```kconfig
osource "/home/ggory15/git/DWM1001_Firmware_Localization/apps/ss_initiator/../../boards/shields/*/Kconfig.defconfig"
osource "/home/ggory15/zephyrproject/zephyr/boards/shields/*/Kconfig.defconfig"
```

## apps/ss_respondor/build/Kconfig/Kconfig.shield.defconfig
```kconfig
osource "/home/ggory15/git/DWM1001_Firmware_Localization/apps/ss_respondor/../../boards/shields/*/Kconfig.defconfig"
osource "/home/ggory15/zephyrproject/zephyr/boards/shields/*/Kconfig.defconfig"
```

## apps/ss_respondor/build/Kconfig/Kconfig.soc.arch
```kconfig
osource "/home/ggory15/zephyrproject/zephyr/soc/$(ARCH)/Kconfig"
osource "/home/ggory15/zephyrproject/zephyr/soc/$(ARCH)/*/Kconfig"
```
